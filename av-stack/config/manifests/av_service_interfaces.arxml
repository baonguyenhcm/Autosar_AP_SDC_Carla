AUTOSAR XML (schema 00052)
package /av/DataTypes
  std cpp implementation data type float64: category=VALUE
  8 x impl type:
    VehicleState: category=STRUCTURE
      5 x element:
        stamp
        x
        y
        yaw
        v
    ControlCommand: category=STRUCTURE
      4 x element:
        stamp
        throttle
        brake
        steer
    DetectedObjectArray: category=VECTOR
    Trajectory: category=VECTOR
    ImuSample: category=STRUCTURE
    GpsSample: category=STRUCTURE
    SpeedSample: category=STRUCTURE
    LidarSample: category=STRUCTURE
package /av/ServiceInterfaces
  5 x service interface:
    SensorService
      namespaces:
        symbol props av
      events:
        4 x data:
          imu: type=ImuSample
          gps: type=GpsSample
          speed: type=SpeedSample
          lidar: type=LidarSample
    VehicleStateService
      events:
        data state: type=VehicleState
    ObjectsService
      events:
        data objects: type=DetectedObjectArray
    TrajectoryService
      events:
        data trajectory: type=Trajectory
    ControlService
      events:
        data command: type=ControlCommand
