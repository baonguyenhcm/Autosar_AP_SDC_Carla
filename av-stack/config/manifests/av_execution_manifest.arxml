AUTOSAR XML (schema 00050)
package /av/Processes
  6 x process:
    carla_gateway: executable=carla_gateway, mode-dependent-startup-config=Driving
    localization_app: executable=localization_app, mode-dependent-startup-config=Driving
    perception_app: executable=perception_app, mode-dependent-startup-config=Active
    planning_app: executable=planning_app, mode-dependent-startup-config=Active
    control_app: executable=control_app, mode-dependent-startup-config{function-group-state=Active, startup-config={scheduling-policy=SCHED-FIFO, scheduling-priority=30}}
    safe_stop_app: executable=safe_stop_app, mode-dependent-startup-config{function-group-state=SafeStop, startup-config={scheduling-policy=SCHED-FIFO, scheduling-priority=40}}
