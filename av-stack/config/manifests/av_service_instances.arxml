AUTOSAR XML (schema 00050)
package /av/ServiceInstances
  provided someip service instance Gateway_SensorService_Provided: service-interface-deployment={service-interface-id=4097, service-interface-version={major-version=1, minor-version=0}}, sd-server-config=initial-offer-behavior={initial-delay-min-value=20, initial-delay-max-value=200}, service-instance-id=1
    someip provided event group SensorEvents: event-group-id=1, event-multicast-udp-port=30510, ipv-4-multicast-ip-address=239.0.1.1
  required someip service instance SensorService_Required: service-interface-deployment={service-interface-id=4097, service-interface-version={major-version=1, minor-version=0}}, someip-required-event-group=event-group-id=1, sd-client-config=initial-find-behavior={initial-delay-min-value=20, initial-delay-max-value=200}
  provided someip service instance Localization_VehicleStateService_Provided: service-interface-deployment={service-interface-id=4098, service-interface-version={major-version=1, minor-version=0}}, sd-server-config=initial-offer-behavior={initial-delay-min-value=20, initial-delay-max-value=200}, service-instance-id=1
    someip provided event group StateEvents: event-group-id=1, event-multicast-udp-port=30511, ipv-4-multicast-ip-address=239.0.1.2
  required someip service instance VehicleStateService_Required: service-interface-deployment={service-interface-id=4098, service-interface-version={major-version=1, minor-version=0}}, someip-required-event-group=event-group-id=1, sd-client-config=initial-find-behavior={initial-delay-min-value=20, initial-delay-max-value=200}
  provided someip service instance Perception_ObjectsService_Provided: service-interface-deployment={service-interface-id=4099, service-interface-version={major-version=1, minor-version=0}}, sd-server-config=initial-offer-behavior={initial-delay-min-value=20, initial-delay-max-value=200}, service-instance-id=1
    someip provided event group ObjectsEvents: event-group-id=1, event-multicast-udp-port=30512, ipv-4-multicast-ip-address=239.0.1.3
  required someip service instance ObjectsService_Required: service-interface-deployment={service-interface-id=4099, service-interface-version={major-version=1, minor-version=0}}, someip-required-event-group=event-group-id=1, sd-client-config=initial-find-behavior={initial-delay-min-value=20, initial-delay-max-value=200}
  provided someip service instance Planning_TrajectoryService_Provided: service-interface-deployment={service-interface-id=4100, service-interface-version={major-version=1, minor-version=0}}, sd-server-config=initial-offer-behavior={initial-delay-min-value=20, initial-delay-max-value=200}, service-instance-id=1
    someip provided event group TrajectoryEvents: event-group-id=1, event-multicast-udp-port=30513, ipv-4-multicast-ip-address=239.0.1.4
  required someip service instance TrajectoryService_Required: service-interface-deployment={service-interface-id=4100, service-interface-version={major-version=1, minor-version=0}}, someip-required-event-group=event-group-id=1, sd-client-config=initial-find-behavior={initial-delay-min-value=20, initial-delay-max-value=200}
  provided someip service instance Control_ControlService_Provided: service-interface-deployment={service-interface-id=4101, service-interface-version={major-version=1, minor-version=0}}, sd-server-config=initial-offer-behavior={initial-delay-min-value=20, initial-delay-max-value=200}, service-instance-id=1
    someip provided event group ControlEvents: event-group-id=1, event-multicast-udp-port=30514, ipv-4-multicast-ip-address=239.0.1.5
  required someip service instance ControlService_Required: service-interface-deployment={service-interface-id=4101, service-interface-version={major-version=1, minor-version=0}}, someip-required-event-group=event-group-id=1, sd-client-config=initial-find-behavior={initial-delay-min-value=20, initial-delay-max-value=200}
