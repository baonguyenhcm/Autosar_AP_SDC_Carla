AUTOSAR XML (schema 00050)
package /av/Machine
  elements someip-service-discovery={multicast-ip-address=224.224.224.245, port=30490, protocol=UDP}:
    machine JetsonOrinNano
    mode declaration group MachineState: initial-mode=Startup
      4 x mode:
        Startup
        Driving
        Parking
        IgnitionOff
    mode declaration group DrivingFG: initial-mode=Off
      mode Off
      mode Active
      mode SafeStop
    communication-cluster:
      ethernet physical channel AvEthernet
        network endpoint JetsonEP: network-endpoint-addresses=ipv-4-configuration=ipv-4-address=192.168.1.50
